## source/embedded/Kconfig
```kconfig
menu "configure app (Tuya-Open-Preview)"

config APP_CONFIG
    bool
    default y
    select ENABLE_AI_COMPONENTS

config TUYA_PRODUCT_ID
    string "product ID of project"
    default "okqfzw6tkrabylcs"

endmenu
```
